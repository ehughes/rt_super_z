## boards/wavenumber/rt_super_b/Kconfig.rt_super_b
```kconfig
# Copyright 2020, 2024 NXP
# SPDX-License-Identifier: Apache-2.0

config BOARD_RT_SUPER_B
	select SOC_PART_NUMBER_MIMXRT685SFVKB
	select SOC_MIMXRT685S_CM33 if BOARD_RT_SUPER_B_MIMXRT685S_CM33
	select SOC_MIMXRT685S_HIFI4 if BOARD_RT_SUPER_B_MIMXRT685S_HIFI4
```

## boards/wavenumber/rt_super_b/board.yml
```yaml
board:
  name: rt_super_b
  full_name: RT Super B
  vendor: wavenumber
  socs:
    - name: mimxrt685s
```

## west.yml
```yaml
manifest:
  defaults:
    revision: main

  remotes:
    - name: zephyrproject-rtos
      url-base: https://github.com/zephyrproject-rtos
    - name: nordic
      url-base: https://github.com/nrfconnect
    - name: ehughes
      url-base: https://github.com/ehughes


  defaults:
    remote: zephyrproject-rtos
    revision: v4.2.0

  projects:

    - name: zephyr
      remote: zephyrproject-rtos
      repo-path: zephyr
      revision: v4.2.0
      import: true

    - name: egfx
      remote: ehughes
      repo-path: egfx
      revision: v2.0
     
      
  self:
    path: rt_super_z
    
```
